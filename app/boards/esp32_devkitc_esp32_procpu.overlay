#include <zephyr/dt-bindings/gpio/gpio.h>

/ {
    aliases {
        led0 = &user_led0;
    };

    leds {
        compatible = "gpio-leds";

        user_led0: led_0 {
            gpios = <&gpio0 2 GPIO_ACTIVE_HIGH>;
            label = "User LED 0";
        };
    };
};
