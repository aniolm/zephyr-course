## west.yml
```yaml
manifest:
  version: 1.0

  projects:
    - name: zephyr
      url: https://github.com/zephyrproject-rtos/zephyr
      revision: v4.2.0
      import:
        path-prefix: deps
```
